## Desktop/ESP32 Wroom/test_mic_oled_project/sdkconfig.defaults
```kconfig
# ============================================================================
# sdkconfig.defaults — test_mic_oled (INMP441 Mic + SSD1306 OLED)
# ============================================================================

CONFIG_IDF_TARGET="esp32s3"

# === Flash ===
CONFIG_ESPTOOLPY_FLASHSIZE_4MB=y
CONFIG_BOOTLOADER_APP_ROLLBACK_ENABLE=y

# === PSRAM (N16R8: 2MB Octal) ===
CONFIG_SPIRAM=y
CONFIG_SPIRAM_MODE_OCT=y
CONFIG_SPIRAM_SPEED_80M=y
CONFIG_SPIRAM_TRY_ALLOCATE_WIFI_LWIP=y
CONFIG_SPIRAM_MEMTEST=y

# === FreeRTOS ===
CONFIG_FREERTOS_HZ=1000

# === Console / UART0 ===
CONFIG_COMPILER_OPTIMIZATION_PERF=y
CONFIG_ESP_CONSOLE_UART=y
CONFIG_ESP_CONSOLE_UART_NUM=0

# === Logs ===
CONFIG_LOG_DEFAULT_LEVEL_INFO=y
CONFIG_LOG_MAXIMUM_LEVEL_INFO=y
CONFIG_LOG_COLORS=y

# === Watchdog ===
CONFIG_ESP_TASK_WDT_INIT=y
CONFIG_ESP_TASK_WDT_TIMEOUT_S=10

# === I2S (INMP441 mic) ===
CONFIG_I2S_ISR_IRAM_SAFE=y
```

## Desktop/ESP32 Wroom/test_oled_project/sdkconfig.defaults
```kconfig
# ============================================================================
# sdkconfig.defaults — Default config cho project test_oled
# ----------------------------------------------------------------------------
# Áp dụng cho ESP32-S3-WROOM-1 (N16R8, 4MB Flash, 2MB Octal PSRAM)
# ============================================================================

# === Target ===
CONFIG_IDF_TARGET="esp32s3"

# === Bootloader / Flash ===
CONFIG_ESPTOOLPY_FLASHSIZE_4MB=y
CONFIG_BOOTLOADER_APP_ROLLBACK_ENABLE=y

# === PSRAM (chip N16R8: 2MB Octal PSRAM) ===
CONFIG_SPIRAM=y
CONFIG_SPIRAM_MODE_OCT=y
CONFIG_SPIRAM_SPEED_80M=y
CONFIG_SPIRAM_TRY_ALLOCATE_WIFI_LWIP=y
CONFIG_SPIRAM_MEMTEST=y

# === FreeRTOS ===
CONFIG_FREERTOS_HZ=1000
CONFIG_ESP_SYSTEM_HLWDT_DETECT=y

# === Console / Linenoise (dùng UART0 ra COM port) ===
CONFIG_COMPILER_OPTIMIZATION_PERF=y
# Tắt USB CDC làm console để log ra UART0 (cổng COM)
CONFIG_ESP_CONSOLE_UART=y
CONFIG_ESP_CONSOLE_UART_NUM=0
CONFIG_ESP_CONSOLE_UART_BAUDRATE_115200=y

# === USB (tắt CDC để tránh xung đột) ===
# Không bật USB CDC làm console - chỉ dùng UART0
REPLACE

# === Logs ===
CONFIG_LOG_DEFAULT_LEVEL_INFO=y
CONFIG_LOG_MAXIMUM_LEVEL_INFO=y
CONFIG_LOG_COLORS=y

# === I2C ===
CONFIG_I2C_MASTER_INTR_LEVEL_DEFAULT=y

# === Watchdog ===
CONFIG_ESP_TASK_WDT_TIMEOUT_S=10
CONFIG_ESP_TASK_WDT=y
```

## Desktop/ESP32 Wroom/test_speaker_project/sdkconfig.defaults
```kconfig
# ============================================================================
# sdkconfig.defaults — Default config cho project test_speaker
# ----------------------------------------------------------------------------
# Áp dụng cho ESP32-S3-WROOM-1 (N16R8, 4MB Flash, 2MB Octal PSRAM)
# ============================================================================

# === Target ===
CONFIG_IDF_TARGET="esp32s3"

# === Bootloader / Flash ===
CONFIG_ESPTOOLPY_FLASHSIZE_4MB=y
CONFIG_BOOTLOADER_APP_ROLLBACK_ENABLE=y

# === PSRAM (chip N16R8: 2MB Octal PSRAM) ===
CONFIG_SPIRAM=y
CONFIG_SPIRAM_MODE_OCT=y
CONFIG_SPIRAM_SPEED_80M=y
CONFIG_SPIRAM_TRY_ALLOCATE_WIFI_LWIP=y
CONFIG_SPIRAM_MEMTEST=y

# === FreeRTOS ===
CONFIG_FREERTOS_HZ=1000

# === Console / Linenoise (dùng UART0 ra COM port) ===
CONFIG_COMPILER_OPTIMIZATION_PERF=y
CONFIG_ESP_CONSOLE_UART=y
CONFIG_ESP_CONSOLE_UART_NUM=0

# === Logs ===
CONFIG_LOG_DEFAULT_LEVEL_INFO=y
CONFIG_LOG_MAXIMUM_LEVEL_INFO=y
CONFIG_LOG_COLORS=y

# === Watchdog ===
CONFIG_ESP_TASK_WDT_TIMEOUT_S=10
CONFIG_ESP_TASK_WDT=y

# === I2S (cần cho MAX98357A) ===
# Driver I2S mới đã có sẵn trong esp-idf; chỉ cần bật log
CONFIG_I2S_ISR_IRAM_SAFE=y
```

## Desktop/ESP32 Wroom/test_web_audio_oled_project/sdkconfig.defaults
```kconfig
# ============================================================================
# sdkconfig.defaults — test_web_audio_oled
# ============================================================================

CONFIG_IDF_TARGET="esp32s3"

# === Flash ===
CONFIG_ESPTOOLPY_FLASHSIZE_4MB=y
CONFIG_BOOTLOADER_APP_ROLLBACK_ENABLE=y

# === PSRAM (N16R8: 2MB Octal) ===
CONFIG_SPIRAM=y
CONFIG_SPIRAM_MODE_OCT=y
CONFIG_SPIRAM_SPEED_80M=y
CONFIG_SPIRAM_TRY_ALLOCATE_WIFI_LWIP=y
CONFIG_SPIRAM_MEMTEST=y

# === FreeRTOS ===
CONFIG_FREERTOS_HZ=1000

# === Console / UART0 ===
CONFIG_COMPILER_OPTIMIZATION_PERF=y
CONFIG_ESP_CONSOLE_UART=y
CONFIG_ESP_CONSOLE_UART_NUM=0

# === Logs ===
CONFIG_LOG_DEFAULT_LEVEL_INFO=y
CONFIG_LOG_MAXIMUM_LEVEL_INFO=y
CONFIG_LOG_COLORS=y

# === Watchdog ===
CONFIG_ESP_TASK_WDT_INIT=y
CONFIG_ESP_TASK_WDT_TIMEOUT_S=15

# === I2S (INMP441 mic) ===
CONFIG_I2S_ISR_IRAM_SAFE=y

# === WiFi ===
CONFIG_ESP_WIFI_ENABLED=y
CONFIG_ESP_WIFI_STATIC_RX_BUFFER_NUM=10
CONFIG_ESP_WIFI_DYNAMIC_RX_BUFFER_NUM=32
CONFIG_ESP_WIFI_DYNAMIC_TX_BUFFER_NUM=32
CONFIG_ESP_WIFI_TX_BA_WIN=6
CONFIG_ESP_WIFI_RX_BA_WIN=6
CONFIG_ESP_WIFI_AMPDU_TX_ENABLED=y
CONFIG_ESP_WIFI_AMPDU_RX_ENABLED=y

# === HTTP Server ===
CONFIG_HTTPD_MAX_REQ_HDR_LEN=1024
CONFIG_HTTPD_MAX_URI_LEN=512
CONFIG_HTTPD_MAX_CONN=4
CONFIG_HTTPD_WS_SUPPORT=y
CONFIG_HTTPD_LRATIO_LIMIT_PER_CORE=0
CONFIG_HTTPD_USE_MALLOC=n
```

## Desktop/ESP32 Wroom/xiaozhi_like/sdkconfig.defaults
```kconfig
# ESP32-S3-WROOM-1 (N16R8: 16MB flash, 8MB Octal PSRAM)
# === Target ===
CONFIG_IDF_TARGET="esp32s3"

# === Flash (16MB) ===
CONFIG_ESPTOOLPY_FLASHSIZE_16MB=y
CONFIG_ESPTOOLPY_FLASHMODE_DIO=y
CONFIG_ESPTOOLPY_FLASHSIZE="16MB"

# === Partition table (single app large) ===
CONFIG_PARTITION_TABLE_SINGLE_APP_LARGE=y
CONFIG_PARTITION_TABLE_CUSTOM=n
CONFIG_PARTITION_TABLE_OFFSET=0x8000

# === Console (UART0 on GPIO43/44 -> COM6 USB-UART bridge) ===
# IMPORTANT: COM6 is a USB-UART bridge (CP2102/CH340), NOT native USB.
# Native USB (GPIO19/20) goes to a different port that we are not connected to.
# Same setting as test_mic_project / test_speaker_project which DO print on COM6.
# Must DISABLE all other console options for UART to take effect.
CONFIG_ESP_CONSOLE_UART=y
CONFIG_ESP_CONSOLE_UART_NUM=0
CONFIG_ESP_CONSOLE_USB_CDC=n
CONFIG_ESP_CONSOLE_USB_SERIAL_JTAG=n
CONFIG_ESP_CONSOLE_UART_CUSTOM=n
CONFIG_ESP_CONSOLE_NONE=n
CONFIG_COMPILER_OPTIMIZATION_PERF=y

# === PSRAM (2MB Octal) ===
CONFIG_SPIRAM=y
CONFIG_SPIRAM_MODE_OCT=y
CONFIG_SPIRAM_SPEED_80M=y
CONFIG_SPIRAM_TRY_ALLOCATE_WIFI_LWIP=y

# === WiFi ===
CONFIG_ESP_WIFI_ENABLED=y
CONFIG_ESP_WIFI_SOFTAP_SUPPORT=n

# === ESP OTA (P4.1) ===
CONFIG_ESP_OTA_OPTI_RAW_BUILD=y
CONFIG_BOOTLOADER_APP_ANTI_ROLLBACK=n
CONFIG_BOOTLOADER_APP_ROLLBACK_ENABLE=n
CONFIG_BOOTLOADER_FACTORY_RESET_ON_BOOT_FAILURE=n
CONFIG_BOOTLOADER_WDT_ENABLE=y
CONFIG_BOOTLOADER_WDT_TIME_MS=30000

# === FreeRTOS ===
CONFIG_FREERTOS_HZ=1000
CONFIG_FREERTOS_TIMER_TASK_STACK_DEPTH=4096

# === Wake word: DISABLED (use GPIO47 button instead) ===
# (custom kconfig, no IDF symbol -- handled in board code)

# === Board type ===
# (custom kconfig, no IDF symbol -- handled in board code)

# === Audio ===
# (custom kconfig, no IDF symbol -- handled in audio_codec.cc)

# === WebSocket (for xiaozhi protocol) ===
CONFIG_ESP_TLS_USING_MBEDTLS=y

# === Certificate Bundle (for TLS/SSL) ===
CONFIG_ESP_CERTIFICATE_BUNDLE=y
CONFIG_ESP_CERTIFICATE_BUNDLE_DEFAULT_FULL=y
```
